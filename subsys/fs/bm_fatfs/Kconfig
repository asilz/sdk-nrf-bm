## subsys/fs/bm_fatfs/Kconfig
```kconfig
#
# Copyright (c) 2026 Nordic Semiconductor ASA
#
# SPDX-License-Identifier: LicenseRef-Nordic-5-Clause
#

menuconfig BM_FATFS
	bool "Bare Metal Zephyr Memory Storage"
	select SQSPI
	help
	  Bare Metal Zephyr Memory Storage library.

if BM_FATFS

config FS_FATFS_WINDOW_ALIGNMENT
	int "Memory alignment for the member \"win\" in FATFS"
	default 1
	help
	  Specifies alignment, in bytes of FAT FS window buffer that is
	  used for device's read/write operations. MMC controllers may
	  require read/write buffer to start at memory address with
	  specific alignment, for example 16 or 512 bytes, the value
	  provided here is used as such alignment. Note that the window
	  buffer is internal element of FATFS structure, which means
	  that, in worst scenario, value provided here may cause FATFS
	  structure to have size of twice the value.

module=BM_FATFS
module-str=BM_FATFS
source "subsys/logging/Kconfig.template.log_config"

endif # BM_FATFS
```

## subsys/fs/fatfs/Kconfig
```kconfig
#
# Copyright (c) 2026 Nordic Semiconductor ASA
#
# SPDX-License-Identifier: LicenseRef-Nordic-5-Clause
#

menuconfig BM_FATFS
	bool "Bare Metal Zephyr Memory Storage"
	select BM_SQSPI
	help
	  Bare Metal Zephyr Memory Storage library.

if BM_FATFS

config BM_FATFS_WINDOW_ALIGNMENT
	int "Memory alignment for the member \"win\" in FATFS"
	default 1
	help
	  Specifies alignment, in bytes of FAT FS window buffer that is
	  used for device's read/write operations. MMC controllers may
	  require read/write buffer to start at memory address with
	  specific alignment, for example 16 or 512 bytes, the value
	  provided here is used as such alignment. Note that the window
	  buffer is internal element of FATFS structure, which means
	  that, in worst scenario, value provided here may cause FATFS
	  structure to have size of twice the value.

config BM_FATFS_IRQ_PRIO
	int "FATFS IRQ priority"
	range 2 7
	default 2
	help
	  Sets the interrupt priority of the GPIOTE peripherals used by the library.
	  Levels are from 2 (highest priority) to 7 (lowest priority).
	  Interrupt priority level must be greater than 4 (softdevice low priority)
	  if you want to call into softdevice from the gpiote driver.

module=BM_FATFS
module-str=BM_FATFS
source "subsys/logging/Kconfig.template.log_config"

endif # BM_FATFS
```

## subsys/softperipheral/Kconfig
```kconfig
#
# Copyright (c) 2026 Nordic Semiconductor
#
# SPDX-License-Identifier: LicenseRef-Nordic-5-Clause
#
menu "Softperipheral"

config BM_SOFTPERIPHERAL
    bool "Softperipheral is present"
    depends on NRFX_GPIOTE


config BM_SQSPI
    bool "Softperipheral QSPI"
    depends on BM_SOFTPERIPHERAL

endmenu
```

## west.yml
```yaml
# The west manifest file for NCS Bare Metal

manifest:
  defaults:
    remote: ncs

  remotes:
    - name: ncs
      url-base: https://github.com/nrfconnect
    - name: zephyr
      url-base: https://github.com/zephyrproject-rtos

  projects:
    - name: nrf
      repo-path: sdk-nrf
      revision: aa634ef1941514771316b2dabe4a4c1e768ffaec
      import:
        name-allowlist:
          - cmsis
          - cmsis_6
          - dragoon
          - hal_nordic
          - lz4
          - mbedtls
          - mcuboot
          - memfault-firmware-sdk
          - nrfxlib
          - picolibc
          - oberon-psa-crypto
          - qcbor
          - segger
          - tinycrypt
          - zephyr
          - cmock
          - zcbor
    - name: sdk-nrf-bm-internal
      path: nrf-bm-internal
      revision: 2086b4bb5ee2cc68b824fe5ecd4e2461987e4c5c
      groups:
        - nrf-bm-internal
    - name: fatfs
      remote: zephyr
      path: fatfs
      revision: 42c2d6ee77e108d2a6d05e862ef0be23511db204

  self:
    path: nrf-bm
```
